## source/main/Kconfig.projbuild
```kconfig
menu "Water Tank Sensor"

    config WT_SENSOR_UART_NUM
        int "UART port used for the A02YYUW sensor"
        range 1 2
        default 2
        help
            Hardware UART connected to the sensor. UART0 is the console/flashing port
            and must not be used here.

    config WT_SENSOR_RX_GPIO
        int "ESP32 RX GPIO (wired to sensor TX, white wire)"
        range 0 39
        default 16
        help
            GPIO receiving the sensor's 9600 baud data frames. Swap with the TX GPIO
            if no data is received and the wiring is reversed (gap G1).
            Note: on ESP32-WROVER modules GPIO16/17 are used by the PSRAM (gap G2).
            GPIO6-11 (SPI flash) and the non-existent GPIO20, 24 and 28-31 are
            rejected at boot: a02yyuw_init logs an error and the firmware aborts.

    config WT_SENSOR_TX_GPIO
        int "ESP32 TX GPIO (wired to sensor RX, yellow wire); -1 = unused"
        range -1 33
        default 17
        help
            The firmware never transmits to the sensor. The idle-HIGH UART TX line
            keeps the sensor in its "processed value" output mode, which is the
            same as leaving the sensor RX wire unconnected. Set to -1 to leave the
            pin unconfigured. Must differ from the RX GPIO. GPIO6-11 (SPI flash) and
            the non-existent GPIO20, 24 and 28-31 are rejected at boot.
            Use -1 while the pin direction is unconfirmed: if the sensor TX wire
            is on this pin, the driven-HIGH TX line would fight the sensor output.

    config WT_REPORT_PERIOD_MS
        int "Distance report period (ms)"
        range 100 60000
        default 1000
        help
            Interval between distance lines printed on the console.

    config WT_SENSOR_STALE_MS
        int "Sensor data stale timeout (ms)"
        range 200 10000
        default 1000
        help
            If no checksum-valid frame was received for longer than this, the
            report shows status=NO_DATA.

    config WT_MEDIAN_FILTER
        bool "Enable median filter on sensor readings"
        default n
        help
            Report the median of the last N valid frames instead of the newest
            raw frame. Useful against splash/condensation outliers.

    config WT_MEDIAN_WINDOW
        int "Median filter window (frames)"
        depends on WT_MEDIAN_FILTER
        range 3 15
        default 5

    menu "Wi-Fi"

        config WT_WIFI_SSID
            string "Wi-Fi SSID"
            default ""
            help
                Fallback when the NVS key wifi_ssid is absent. Empty = Wi-Fi off
                (no web report, no Home Assistant). Shared by every network
                feature (components/wt_wifi).

        config WT_WIFI_PASSWORD
            string "Wi-Fi password"
            default ""
            help
                Fallback when the NVS key wifi_pass is absent. Empty = open network,
                otherwise at least 8 characters (WPA2/WPA3). Never logged.

        config WT_WIFI_HOSTNAME
            string "Network hostname"
            default "espwatertank"
            help
                Hostname of the Wi-Fi station interface, sent to the router in the
                DHCP request (option 12) and shown in its client list. Letters,
                digits and '-', at most 32 characters. No mDNS: the board does not
                answer espwatertank.local unless the router publishes DHCP names
                in its DNS.

    endmenu

    menu "Web report (PHP server)"

        config WT_WEB_ENABLE
            bool "Post readings to a PHP endpoint over HTTP(S)"
            default y
            help
                Builds the web_report component: once Wi-Fi is up, the newest
                reading is POSTed (form-encoded) to the URL below every
                WT_WEB_POST_PERIOD_MS. Server side: web/water/ in this repository.

        config WT_WEB_POST_URL
            string "POST endpoint URL"
            depends on WT_WEB_ENABLE
            default "https://randoresto.ch/water/post.php"
            help
                Fallback when the NVS key web_url is absent. Empty disables the web
                report at runtime. https:// URLs are verified against the ESP-IDF
                certificate bundle.

        config WT_WEB_API_KEY
            string "API key (must match $config['api_key'] in config.php)"
            depends on WT_WEB_ENABLE
            default ""
            help
                Fallback when the NVS key web_key is absent. Sent as the form field
                "key"; the server rejects posts with a wrong key. Never logged.

        config WT_WEB_POST_PERIOD_MS
            int "Post interval (ms)"
            depends on WT_WEB_ENABLE
            range 5000 3600000
            default 60000
            help
                One HTTP request per interval. A post is also sent at once when the
                sensor goes to or from NO_DATA. The console report is not affected.

    endmenu

    menu "Home Assistant"

        config WT_HA_ENABLE
            bool "Compile in Home Assistant (MQTT discovery)"
            default y
            help
                Builds the ha_mqtt component. At boot it only starts MQTT if a
                Wi-Fi SSID and a broker URI are configured (NVS namespace "wt_cfg"
                first, then the Kconfig values). Otherwise it logs "ha: disabled".

        config WT_MQTT_BROKER_URI
            string "MQTT broker URI"
            depends on WT_HA_ENABLE
            default ""
            help
                Fallback when the NVS key mqtt_uri is absent, e.g.
                mqtt://192.168.1.10:1883. Empty disables Home Assistant at runtime.

        config WT_MQTT_USERNAME
            string "MQTT username"
            depends on WT_HA_ENABLE
            default ""
            help
                Fallback when the NVS key mqtt_user is absent. Empty = anonymous.

        config WT_MQTT_PASSWORD
            string "MQTT password"
            depends on WT_HA_ENABLE
            default ""
            help
                Fallback when the NVS key mqtt_pass is absent. Never put it in
                sdkconfig.defaults.

        config WT_HA_PUBLISH_PERIOD_MS
            int "Minimum state publish interval (ms)"
            depends on WT_HA_ENABLE
            range 1000 600000
            default 10000
            help
                The state is published at most this often, and additionally at
                once when the sensor goes to or from NO_DATA. The console report
                period is not affected.

        config WT_HA_DISCOVERY_PREFIX
            string "Home Assistant discovery prefix"
            depends on WT_HA_ENABLE
            default "homeassistant"

    endmenu

endmenu
```
